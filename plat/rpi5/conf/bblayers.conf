## plat/rpi5/conf/bblayers.conf
```bitbake
POKY_BBLAYERS_CONF_VERSION = "2"
BBPATH = "${TOPDIR}"
BBFILES ?= ""
LAYERS = "${TOPDIR}/../layers"
BBLAYERS ?= " \
  ${LAYERS}/poky/meta \
  ${LAYERS}/poky/meta-poky \
  ${LAYERS}/poky/meta-yocto-bsp \
  ${LAYERS}/meta-openembedded/meta-oe \
  ${LAYERS}/meta-openembedded/meta-python \
  ${LAYERS}/meta-openembedded/meta-networking \
  ${LAYERS}/meta-raspberrypi \
  ${TOPDIR}/../meta-caneo \
  "
```

## plat/rpi5/meta-caneo/conf/layer.conf
```bitbake
BBPATH .= ":${LAYERDIR}"
BBFILES += "${LAYERDIR}/recipes-*/*/*.bb ${LAYERDIR}/recipes-*/*/*.bbappend"
BBFILE_COLLECTIONS += "caneo"
BBFILE_PATTERN_caneo = "^${LAYERDIR}/"
BBFILE_PRIORITY_caneo = "10"
LAYERDEPENDS_caneo = "core raspberrypi openembedded-layer"
LAYERSERIES_COMPAT_caneo = "scarthgap"
```
